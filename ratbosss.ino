#include <time.h>
#include <Wire.h>
#include <Adafruit_GFX.h>
#include <Adafruit_SSD1306.h>
#include <Adafruit_BME280.h>
#include <WiFi.h>
#include "BluetoothA2DPSink.h"
#include "ESP_I2S.h"
#include <ezButton.h>

#define SCREEN_WIDTH 128 //屏幕宽
#define SCREEN_HEIGHT 64  //屏幕高

#define OLED_RESET -1
#define SCREEN_ADDRESS 0x3C

//wifi配置参数
#define NTP_SERVER     "pool.ntp.org"
#define ETC_OFFSET     -5 * 3600   // 美国东部标准时间 UTC-5
#define ETC_OFFSET_DST 0           // 如果暂时不考虑夏令时，写 0 就行

//jotstick参数配置
#define VRX_PIN  23 // ESP32 pin GPIO23 (ADC3) connected to VRX pin
#define VRY_PIN  33 // ESP32 pin GPIO33 (ADC0) connected to VRY pin
#define SW_PIN   19 // ESP32 pin GPIO32 connected to SW  pin

//jotstick参数配置
int valueX = 0; // to store the X-axis value
int valueY = 0; // to store the Y-axis value
int bValue = 0; // To store value of the button

//按钮切换
int screenState = 0;  // 0 = BME280界面, 1 = 时间界面

//功放参数配置
const int BCLK_PIN  = 26;  // MAX98357A BCLK
const int LRCLK_PIN = 25;  // MAX98357A LRC / LRCLK / WS
const int DATA_PIN  = 27;  // MAX98357A DIN

Adafruit_SSD1306 display(SCREEN_WIDTH,SCREEN_HEIGHT, &Wire, OLED_RESET);//初始化
Adafruit_BME280 bme;
I2SClass i2s;
BluetoothA2DPSink a2dp_sink(i2s);
ezButton button(SW_PIN);



const unsigned char epd_bitmap_LISANG [] PROGMEM = { //李桑点阵图
	0xff, 0xff, 0xff, 0xff, 0xff, 0xff, 0xff, 0xfc, 0xff, 0xff, 0xff, 0xe1, 0xff, 0xff, 0xff, 0xfc, 
	0xff, 0xff, 0xfe, 0x00, 0x7f, 0xff, 0xff, 0xfc, 0xff, 0xff, 0xf8, 0x00, 0x00, 0xff, 0xff, 0xfc, 
	0xff, 0xff, 0xe0, 0x00, 0x00, 0x7f, 0xff, 0xfc, 0xff, 0xff, 0xc0, 0x00, 0x00, 0x3f, 0xff, 0xfc, 
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	0xff, 0xff, 0xe0, 0x1f, 0xf0, 0x1f, 0xff, 0xe0, 0xff, 0xff, 0xfc, 0x00, 0x00, 0xff, 0xff, 0xe0
};

const unsigned char epd_bitmap_Li_sang_glass_dot [] PROGMEM = {
	0x00, 0x00, 0x00, 0x00, 0x7f, 0xff, 0xff, 0xff, 0xff, 0xff, 0xff, 0xff, 0xf8, 0x00, 0x00, 0x00, 
	0x00, 0x00, 0x00, 0x00, 0xff, 0xff, 0xff, 0xff, 0xff, 0xff, 0xff, 0xff, 0xf8, 0x00, 0x00, 0x00, 
	0x00, 0x00, 0x00, 0x00, 0xff, 0xff, 0xff, 0xff, 0xff, 0xff, 0xff, 0xff, 0xfc, 0x00, 0x00, 0x00, 
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	0x00, 0x1f, 0xff, 0xff, 0xff, 0xff, 0x00, 0x00, 0x00, 0x3f, 0xff, 0xff, 0xff, 0xf0, 0x00, 0x03
};


void setup() {
  Serial.begin(115200);

	Serial.println("Starting ESP32 Bluetooth Speaker...");
	//屏幕启动
	if(!display.begin(SSD1306_SWITCHCAPVCC,SCREEN_ADDRESS)){
    Serial.println(F("SSD1306 allocation failed"));
    for(;;);
  }
	//温度传感器启动
   if (!bme.begin(0x77)) {
    Serial.println("BME280 init failed at 0x77");
    while (1) {
      delay(1000);
    }
  } 
  // 1. 配置 I2S 引脚
  i2s.setPins(BCLK_PIN, LRCLK_PIN, DATA_PIN);

  // 2. 初始化 I2S：标准 I2S，44.1kHz, 16bit, 立体声
  if (!i2s.begin(I2S_MODE_STD,
                 44100,
                 I2S_DATA_BIT_WIDTH_16BIT,
                 I2S_SLOT_MODE_STEREO,
                 I2S_STD_SLOT_BOTH)) {
    Serial.println("I2S init failed!");
    while (1) { delay(1000); }
  }

  Serial.println("I2S OK, start Bluetooth A2DP...");

  // 3. 设置音量（0~100）
  a2dp_sink.set_volume(80);

  // 4. 启动蓝牙音箱，手机上会看到这个名字
  a2dp_sink.start("智能出生管家");

  Serial.println("Bluetooth A2DP started as ESP32-Speaker");

  Serial.println("BME280 OK, OLED OK,WIFI OK");

	 //wifi 链接
   WiFi.begin("corvette best", "manual51");
  while (WiFi.status() != WL_CONNECTED) {
    display.println("Connecting to Wifi");
    display.display();
    delay(1000); 
  }
  display.clearDisplay();

//初始化时间
  configTime(ETC_OFFSET, ETC_OFFSET_DST, NTP_SERVER);
	
	//初始化按钮
	analogSetAttenuation(ADC_11db);
  button.setDebounceTime(50); // set debounce time to 50 milliseconds


	printHL();
	printRB();
  display.clearDisplay();

}



void getdata(){
	float T = bme.readTemperature();      // °C
  float P = bme.readPressure() / 100.0; // hPa
  float H = bme.readHumidity(); 				// %
	display.clearDisplay();
  display.setTextSize(1);
  display.setTextColor(WHITE);
  display.setCursor(0, 1);
	 display.println("TEMP: ");
	 display.println(T);
	 display.println("Humidity: ");
	 display.print(H);
	  display.println("%");
	 display.println("Press: ");
	 display.print(P);
	  display.println("KPA");
		display.drawBitmap(66,0,epd_bitmap_LISANG, 62,64, WHITE);
	  display.display();
	 delay(1000);
}

void printHL(){
   display.clearDisplay();
  display.setTextSize(1);
  display.setTextColor(WHITE);
  display.setCursor(0, 1);
  display.println("Everthing start from here the Founderstone of Chang");
  display.display();
  delay(2000);
  display.clearDisplay();
}

void printRB(){
   display.clearDisplay();
  display.drawBitmap((128-62)/2,0,epd_bitmap_LISANG, 62,64, WHITE);
  display.display();
  delay(1000);
  display.clearDisplay();
}

void printRB2(){
   display.clearDisplay();
  display.drawBitmap(0,0,epd_bitmap_Li_sang_glass_dot, 128,64, WHITE);
  display.display();
  delay(1000);
  display.clearDisplay();
}

//时间模块
void printLocalTime() {
  struct tm timeinfo;
    if (!getLocalTime(&timeinfo)) {
    display.clearDisplay();
    display.setCursor(0, 0);
    display.println("Connection Err");
    display.display();
    return;
  }

  display.clearDisplay();

  display.setTextSize(1);
  display.setTextColor(SSD1306_WHITE);

  display.setCursor(0, 0);
  display.println(&timeinfo, "%H:%M:%S");

  display.setCursor(0, 16);
  display.println(&timeinfo, "%d/%m/%Y");

  display.setCursor(0, 32);
  display.println("ETC");

  display.drawBitmap(66, 0, epd_bitmap_LISANG, 62, 64, WHITE);

  display.display();
}

void loop() {

   button.loop(); // 按键必须每次循环检查

	
  // 检测按下：界面在 0,1,2 之间循环
  if (button.isPressed()) {
			
		  
   
    if (button.isPressed()) { 
			screenState = (screenState + 1) % 3; // 0 -> 1 -> 2 -> 0 -> ... 
			Serial.print("Screen toggled! screenState = "); 
			Serial.println(screenState); }
  }

  // 根据当前界面选择显示内容
  if(screenState == 0){
    printRB2();
  }else if (screenState == 1) {
    getdata();          // 显示温度、湿度、气压
  } else if(screenState == 2) {
    printLocalTime();   // 显示时间
  }
}
